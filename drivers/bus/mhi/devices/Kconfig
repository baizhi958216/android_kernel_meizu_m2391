## drivers/soc/qcom/dcvs/Kconfig
```kconfig
# SPDX-License-Identifier: GPL-2.0-only
config QCOM_DCVS_FP
	tristate "Enable QCOM DCVS Fast Path Interface"
	depends on ARCH_QCOM && QCOM_RPMH
	default n
	help
	  This enables the QCOM DCVS FP (Fast Path) driver which relies on
	  certain "fast path" APIs from QCOM_RPMH to vote for various DCVS HW
	  blocks in a faster scheme than standard voting paths. This requires a
	  Qualcomm Technologies, Inc. (QTI) chipset that supports this feature.

config QCOM_DCVS
	tristate "QCOM DCVS Driver"
	depends on ARCH_QCOM && OF
	depends on QCOM_DCVS_FP || !QCOM_DCVS_FP
	select INTERCONNECT
	default n
	help
	  This enables the main QCOM DCVS framework which supports various
	  DCVS HW blocks and voting interfaces that are supported on some
	  Qualcomm Technologies, Inc. (QTI) chipsets. This includes voting
	  interfaces from both QCOM_DCVS_FP and INTERCONNECT.

config QTI_C1DCVS_SCMI_CLIENT
	tristate "Qualcomm CPUCP C1DCVS"
	depends on QTI_SCMI_C1DCVS_PROTOCOL
```

## drivers/soc/qcom/mem_buf/Kconfig
```kconfig
# SPDX-License-Identifier: GPL-2.0-only

config QCOM_MEM_BUF_DEV
	tristate "Qualcomm Kalama DMA-BUF VM permissions"
	depends on DMA_SHARED_BUFFER && QCOM_SECURE_BUFFER && GUNYAH_KALAMA_RM
	depends on ZONE_DEVICE
	help
	  Track buffer ACLs and transfer memory between HLOS, peripheral VMs
	  and Gunyah guests through SCM and the Resource Manager.

config QCOM_MEM_BUF_MSGQ
	tristate "Qualcomm Kalama memory parcel request channel"
	depends on QCOM_MEM_BUF_DEV

config QCOM_MEM_BUF
	tristate "Qualcomm Kalama host memory supplier"
	depends on QCOM_MEM_BUF_MSGQ && QCOM_DMABUF_HEAPS
	help
	  Supply protected memory to the trusted VM and expose the Android
	  /dev/membuf lend, share, retrieve and reclaim operations.
```

## drivers/thermal/qcom/Kconfig
```kconfig
# SPDX-License-Identifier: GPL-2.0-only
config QCOM_TSENS
	tristate "Qualcomm TSENS Temperature Alarm"
	depends on NVMEM_QCOM_QFPROM
	depends on ARCH_QCOM || COMPILE_TEST
	help
	  This enables the thermal sysfs driver for the TSENS device. It shows
	  up in Sysfs as a thermal zone with multiple trip points. Disabling the
	  thermal zone device via the mode file results in disabling the sensor.
	  Also able to set threshold temperature for both hot and cold and update
	  when a threshold is reached.

config QCOM_SPMI_ADC_TM5_GEN3
	tristate "Qualcomm PMIC5 Gen3 thermal monitor"
	depends on QCOM_SPMI_ADC5_GEN3
	help
	  Program high and low threshold events on the Gen3 SDAM sequencer
	  and expose thermistors through the thermal framework.

config QCOM_SPMI_ADC_TM5
	tristate "Qualcomm SPMI PMIC Thermal Monitor ADC5"
	depends on OF && SPMI && IIO
	select REGMAP_SPMI
	select QCOM_VADC_COMMON
	help
	  This enables the thermal driver for the ADC thermal monitoring
	  device. It shows up as a thermal zone with multiple trip points.
	  Thermal client sets threshold temperature for both warm and cool and
	  gets updated when a threshold is reached.

config QCOM_SPMI_TEMP_ALARM
	tristate "Qualcomm SPMI PMIC Temperature Alarm"
	depends on OF && SPMI && IIO
	select REGMAP_SPMI
	help
	  This enables a thermal sysfs driver for Qualcomm plug-and-play (QPNP)
	  PMIC devices. It shows up in sysfs as a thermal sensor with multiple
	  trip points. The temperature reported by the thermal sensor reflects the
	  real time die temperature if an ADC is present or an estimate of the
	  temperature based upon the over temperature stage value.

config QCOM_LMH
	tristate "Qualcomm Limits Management Hardware"
	depends on ARCH_QCOM || COMPILE_TEST
	select QCOM_SCM
	help
	  This enables initialization of Qualcomm limits management
	  hardware(LMh). LMh allows for hardware-enforced mitigation for cpus based on
	  input from temperature and current sensors.  On many newer Qualcomm SoCs
	  LMh is configured in the firmware and this feature need not be enabled.
	  However, on certain SoCs like sdm845 LMh has to be configured from kernel.

source "drivers/thermal/qcom/Kconfig.m2391-sensors"

config MEIZU_THERMAL_BOOST
	tristate "Meizu thermal boost control"
	depends on CPU_FREQ && PROC_FS

config QTI_CPUFREQ_CDEV
	tristate "Qualcomm CPU cluster frequency cooling"
	depends on CPU_FREQ && OF && (MEIZU_THERMAL_BOOST || !MEIZU_THERMAL_BOOST)

config QTI_CPU_VOLTAGE_COOLING_DEVICE
	tristate "Qualcomm shared CPU rail cooling"
	depends on CPU_FREQ && PM_OPP && OF

config QTI_QMI_COOLING_DEVICE
	tristate "Qualcomm thermal mitigation service"
	depends on QCOM_QMI_HELPERS && NET && OF

config QTI_CPU_HOTPLUG_COOLING_DEVICE
	tristate "Qualcomm CPU hotplug cooling"
	depends on HOTPLUG_CPU && OF

config QTI_DDR_COOLING_DEVICE
	tristate "Qualcomm DDR interconnect cooling votes"
	depends on INTERCONNECT && OF

config QTI_USERSPACE_CDEV
	tristate "Qualcomm userspace cooling devices"
	depends on OF

config QTI_CPU_PAUSE_COOLING_DEVICE
	tristate "Qualcomm CPU pause cooling"
	depends on SCHED_WALT && OF

config QTI_THERMAL_LIMITS_DCVS
	tristate "Qualcomm firmware LMh current-sense references"
	depends on OF && REGULATOR

config QTI_DEVFREQ_CDEV
	tristate "Qualcomm GPU thermal HAL cooling vote"
	depends on OF && DEVFREQ_THERMAL
```

## drivers/thermal/qcom/Kconfig.m2391-sensors
```kconfig
# SPDX-License-Identifier: GPL-2.0-only
config QTI_QMI_SENSOR_V2
	tristate "Qualcomm remote thermal sensor service v2"
	depends on QCOM_QMI_HELPERS && THERMAL_OF && NET
	help
	  Discover modem thermal sensors over QRTR, read temperature indications
	  and program high and low thresholds in the remote sensor service.

config QTI_BCL_PMIC5
	tristate "Qualcomm PMIC5 battery current limiting monitor"
	depends on SPMI && THERMAL_OF
	help
	  Read instantaneous battery voltage and current and expose PMIC hardware
	  limit comparators to the thermal policy.

config QTI_BCL_SOC_DRIVER
	tristate "Qualcomm battery state-of-charge depletion sensor"
	depends on POWER_SUPPLY && THERMAL_OF
	help
	  Update the depletion thermal zone when the battery supply changes.
```

## drivers/virt/gunyah/Kconfig
```kconfig
# SPDX-License-Identifier: GPL-2.0-only

config GUNYAH_HYPERCALLS
	tristate

config GUNYAH_TIMER
	tristate

config GUNYAH
	tristate "Gunyah Virtualization drivers"
	depends on ARM64
	select GUNYAH_PLATFORM_HOOKS
	select AUXILIARY_BUS
	imply GUNYAH_QCOM_PLATFORM if ARCH_QCOM
	select GUNYAH_HYPERCALLS
	select GUNYAH_TIMER
	depends on SYSFS
	select SYS_HYPERVISOR
	help
	  The Gunyah drivers are the helper interfaces that run in a guest VM
	  such as basic inter-VM IPC and signaling mechanisms, and higher level
	  services such as memory/device sharing, IRQ sharing, and so on.

	  Say Y/M here to enable the drivers needed to interact in a Gunyah
	  virtual environment.

config GUNYAH_PLATFORM_HOOKS
	tristate

config GUNYAH_QCOM_PLATFORM
	tristate "Support for Gunyah on Qualcomm platforms"
	depends on GUNYAH
	select GUNYAH_PLATFORM_HOOKS
	select QCOM_SCM
	help
	  Enable support for interacting with Gunyah on Qualcomm
	  platforms. Interaction with Qualcomm firmware requires
	  extra platform-specific support.

	  Say Y/M here to use Gunyah on Qualcomm platforms.

config GUNYAH_IRQFD
	tristate "Gunyah irqfd interface"
	depends on GUNYAH
	help
	  Enable kernel support for creating irqfds which can raise an interrupt
	  on Gunyah virtual machine.

	  Say Y/M here if unsure and you want to support Gunyah VMMs.

config GUNYAH_IOEVENTFD
	tristate "Gunyah ioeventfd interface"
	depends on GUNYAH
	help
	  Enable kernel support for creating ioeventfds which can alert userspace
	  when a Gunyah virtual machine accesses a memory address.

	  Say Y/M here if unsure and you want to support Gunyah VMMs.

config GUNYAH_QCOM_TRUSTED_VM
	tristate "Gunyah Qualcomm Trusted VM Support"
	depends on GUNYAH
	help
	  Enable kernel support for creating Qualcomm Trusted VMs.
	  They are a kind of protected VM which is authenticated by the
	  firmware.

	  Say Y/M here if unsure and you want to support QTVMs.

config GUNYAH_KALAMA_RM
	tristate "Kalama firmware resource manager and trusted peripheral lending"
	depends on ARM64 && OF && ARCH_QCOM
	help
	  Handle the original RM 1.0 message queues, doorbells, virtual IRQs
	  and memory parcels exposed by the Kalama boot firmware. The trusted
	  touch client uses these services to transfer its controller and IRQ
	  between the phone OS and the trusted VM.

config GUNYAH_KALAMA_VM
	tristate "Kalama secure VM userspace interface"
	depends on GUNYAH_KALAMA_RM && QCOM_MDT_LOADER && QCOM_SECURE_BUFFER
	depends on EVENTFD && SYSFS
	select SYS_HYPERVISOR
	help
	  Load the firmware specified by Kalama's secure VM device tree and
	  expose its virtio backend and vCPU scheduling ABI to the vendor VMM.
```
